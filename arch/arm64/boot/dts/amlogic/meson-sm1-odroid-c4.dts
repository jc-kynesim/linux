// SPDX-License-Identifier: (GPL-2.0+ OR MIT)
/*
 * Copyright (c) 2020 Dongjin Kim <tobetter@gmail.com>
 */

/dts-v1/;

#include "meson-sm1-odroid.dtsi"

/ {
	compatible = "hardkernel,odroid-c4", "amlogic,sm1";
	model = "Hardkernel ODROID-C4";

	hub_5v: regulator-hub_5v {
		/* Connected to the Hub CHIPENABLE, LOW sets low power state */
		gpio = <&gpio GPIOH_4 GPIO_ACTIVE_HIGH>;
		enable-active-high;
	};
};

&gpio {
        /*
         * WARNING: The USB Hub on the Odroid-C4 needs a reset signal
         * to be turned high in order to be detected by the USB Controller
         * This signal should be handled by a USB specific power sequence
         * in order to reset the Hub when USB bus is powered down.
         */
        usb-hub {
                gpio-hog;
                gpios = <GPIOH_4 GPIO_ACTIVE_HIGH>;
                output-high;
                line-name = "usb-hub-reset";
        };
};
